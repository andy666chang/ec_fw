## develope/modules/boards/arm/mec1723_n1x/Kconfig.board
```kconfig
# Copyright (c) 2024, Microchip Technology Inc.
# SPDX-License-Identifier: Apache-2.0

config BOARD_MEC1723_N1X
	bool "Microchip MEC1723 N1X Development board"
	depends on SOC_MEC172X_NSZ
```

## develope/modules/boards/microchip/nv_n1/board.yml
```yaml
boards:
- name: nv_n1x_yukon
  vendor: microchip
  socs:
    - name: mec172x_nsz
  revision:
    format: custom
    default: b00
    exact: true
    revisions:
    - name: b00
    - name: b01
- name: nv_n1c_tango
  vendor: microchip
  socs:
    - name: mec172x_nsz
  revision:
    format: custom
    default: a00
    exact: true
    revisions:
    - name: a00
    - name: a01
```

## develope/modules/boards/microchip/nv_n1/nv_n1c_tango_defconfig
```kconfig
#
# Copyright (c) 2024, Microchip Technology Inc.
#
# SPDX-License-Identifier: Apache-2.0
#

CONFIG_BOARD_NV_N1C_TANGO=y
CONFIG_RTOS_TIMER=y
# CONFIG_THERMAL_MANAGEMENT=y
CONFIG_CLOCK_CONTROL=y
CONFIG_GPIO=y
CONFIG_PINCTRL=y
CONFIG_SERIAL=y
CONFIG_CONSOLE=y
CONFIG_UART_CONSOLE=y
CONFIG_ADC=y
CONFIG_I2C=y
CONFIG_ESPI=y
CONFIG_SPI=y
CONFIG_SPI_ASYNC=y

CONFIG_FPU=n
```

## develope/modules/boards/microchip/nv_n1x_yukon/Kconfig.nv_n1c_tango
```kconfig
# Copyright (c) 2024, Microchip Technology Inc.
# SPDX-License-Identifier: Apache-2.0

config BOARD_NV_N1C_TANGO
	bool "NVDIA MEC1723 N1X YUKON board"
	select SOC_MEC172X_NSZ

config BOARD
	default "nv_n1c_tango"
```

## develope/modules/boards/microchip/nv_n1x_yukon/Kconfig.nv_n1x_yukon
```kconfig
# Copyright (c) 2024, Microchip Technology Inc.
# SPDX-License-Identifier: Apache-2.0

config BOARD_NV_N1X_YUKON
	bool "NVDIA MEC1723 N1X YUKON board"
	select SOC_MEC172X_NSZ
```

## develope/modules/boards/microchip/nv_n1x_yukon/board.yml
```yaml
board:
  name: nv_n1x_yukon
  vendor: microchip
  socs:
    - name: mec172x_nsz
  revision:
    format: custom
    default: b00
    exact: true
    revisions:
    - name: b00
    - name: b01
```

## develope/modules/drivers/sensor/ti/tmp451/Kconfig
```kconfig
config SENSOR_TMP451
    bool "TMP451 temperature sensor"
    depends on I2C
    help
      Enable support for the TI TMP451 temperature sensor.

config TMP451_ALERT_THERM2_MODE
    bool "TMP451 ALERT/THERM2 Pin Configuration"
    default y
    help
      Choose pin 6 output mode:
      If y, Pin 6 is configured as THERM2 output.
      If n, Pin 6 is configured as ALERT output (default in datasheet).

config TMP451_CONVERSION_RATE
    int "TMP451 Conversion Rate"
    default 8
    range 0 9
    help
      Sets the conversion rate for the TMP451.
      0: 0.0625 conv/s, 1: 0.125 conv/s, ..., 8: 16 conv/s (default), 9: 32 conv/s.
      Default to 16 conversions/sec
      Refer to Table 9 in datasheet for valid values

config TMP451_DIGITAL_FILTER_LEVEL
    int "TMP451 Digital Filter Level"
    default 0
    range 0 2
    help
      Configures the digital filter for remote temperature measurements.
      0: Averaging off (default)
      1: Moving average of 4 consecutive samples
      2: Moving average of 8 consecutive samples
```

## develope/modules/subsys/app_event_manager/Kconfig
```kconfig
menuconfig APP_EVENT_MANAGER
	bool
	prompt "Application Event Manager"
	help
	  Enable Application Event Manager.

if APP_EVENT_MANAGER

config APP_EVENT_MANAGER_SHELL
	bool "Enable shell integration"
	depends on SHELL
	default n
	help
	  Enable Event Manager shell commands to display information about
	  listeners, subscribers and events. The commands also allow to
	  dynamically enable or disable logging for given event types.

endif # APP_EVENT_MANAGER
```

## tools/west.yml
```yaml
manifest:
  version: "0.12"

  defaults:
    remote: upstream

  remotes:
    - name: upstream
      url-base: https://github.com/zephyrproject-rtos

  projects:
    - name: zephyr_kernel
      repo-path: zephyr.git
      path: zephyr_3.7.0/zephyr_kernel
      remote: upstream
      revision: v3.7.0
      clone-depth: 1
      west-commands: scripts/west-commands.yml

    - name: cmsis
      path: zephyr_3.7.0/modules/hal/cmsis
      remote: upstream
      revision: 4b96cbb174678dcd3ca86e11e1f24bc5f8726da0

    - name: hal_microchip
      path: zephyr_3.7.0/modules/hal/microchip
      remote: upstream
      revision: 71eba057c0cb7fc11b6f33eb40a82f1ebe2c571c

  self:
    path: zephyr_3.7.0
```
